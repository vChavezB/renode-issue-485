## west.yml
```yaml
manifest:

  remotes:
    - name: zephyrproject-rtos
      url-base: https://github.com/zephyrproject-rtos

  projects:
    - name: zephyr
      remote: zephyrproject-rtos
      revision: d034106b4035f26002c938f33ed59f6802ff235b
      path: zephyr
      import:
        name-allowlist:
          - hal_nordic
          - cmsis
          - tinycrypt
```
